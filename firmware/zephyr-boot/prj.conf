## CMakeLists.txt
```
# EviCon cutoff firmware with the boot report (release 087, PREREG_extra_087.md item B; reviewer comment M3).
#
# The measured firmware (../zephyr-cutoff) is frozen by the plans 074-086 and is not rebuilt. This application builds
# its sources unchanged (../zephyr-cutoff/src/main.c, evc_core.c, evc_proto.c; as ../zephyr-mcu and ../zephyr-auth do)
# plus src/evc_boot_report.c. Three calls of main.c are redirected to it when main.c is compiled here, so that no source
# line changes:
#   evc_core_init   -> evc_boot_core_init     records the claim floor F: the claim mark restored at this boot
#                                             (persisted hw_limit; 0 on a fresh flash), then calls evc_core_init
#   mqtt_publish    -> evc_boot_mqtt_publish  every reply (cmd, query, stop, fence, ping) carries "floor":F
#   mqtt_subscribe  -> evc_boot_mqtt_subscribe after every (re)connect's subscription, a hello {"device","hello","floor"}
#                                             on <ns>/<dev>/hello, so that the gateway learns F before the next command
# The decision core, the durable state and the flash writes are those of the measured firmware.
cmake_minimum_required(VERSION 3.20.0)
find_package(Zephyr REQUIRED HINTS $ENV{ZEPHYR_BASE})
project(evc_boot_firmware)

set(EVC_SRC ${CMAKE_CURRENT_SOURCE_DIR}/../zephyr-cutoff/src)
target_include_directories(app PRIVATE ${EVC_SRC} src)
target_sources(app PRIVATE ${EVC_SRC}/evc_core.c ${EVC_SRC}/main.c ${EVC_SRC}/evc_proto.c src/evc_boot_report.c)
target_compile_definitions(app PRIVATE EVC_RING_SLOTS=${CONFIG_EVC_RING_SLOTS} EVC_TOMB_SLOTS=${CONFIG_EVC_TOMB_SLOTS})
set_source_files_properties(${EVC_SRC}/main.c PROPERTIES COMPILE_DEFINITIONS
  "evc_core_init=evc_boot_core_init;mqtt_publish=evc_boot_mqtt_publish;mqtt_subscribe=evc_boot_mqtt_subscribe")
```

## Kconfig
```
# Release 087: the Kconfig of ../zephyr-cutoff (frozen), copied unchanged except the menu title: firmware/zephyr-boot builds
# the frozen sources of ../zephyr-cutoff/src with the boot report (src/evc_boot_report.c).
mainmenu "EviCon cutoff firmware with the boot report (release 087)"

config EVC_FOOTPRINT_ONLY
	bool "Build the core without networking (footprint report)"

config EVC_DEVICE_ID
	string "Device ID (MQTT client ID, topic segment, plant device)"
	default "zephyr-1"

config EVC_BROKER_ADDR
	string "MQTT broker IPv4 address"
	default "192.168.107.152"

config EVC_BROKER_PORT
	int "MQTT broker port"
	default 1883

config EVC_PLANT_ADDR
	string "evicon-plant TCP line-protocol address"
	default "127.0.0.1"

config EVC_PLANT_PORT
	int "evicon-plant TCP line-protocol port"
	default 18092

config EVC_RING_SLOTS
	int "Receipt/dedup ring entries"
	default 32

config EVC_TOMB_SLOTS
	int "Durable tombstone table entries (stop fails with ENOSPC when full)"
	default 16

config EVC_DEDUP_HORIZON_MS
	int "Dedup horizon in ms (0 none, -1 ring-bounded only)"
	default -1

config EVC_BOUND
	int "Device-side cumulative limit (0 none)"
	default 0

config EVC_STOP
	bool "Per-identity stop (durable tombstone table, EVC_TOMB_SLOTS entries)"

config EVC_GUARD_EVICTED
	bool "Answer UNCERTAIN instead of executing an identity whose receipt may be lost"
	default y
	help
	  With this guard a command whose sequence is at or below the eviction
	  watermark (ring eviction, effect with unknown result, or reboot) and that
	  has no receipt is never executed again. Disable only as a negative control
	  (ring-bounded dedup that duplicates after eviction).

config EVC_EXPIRY
	bool "Owner-enforced expiry (needs SNTP-synchronised CLOCK_REALTIME)"

source "Kconfig.zephyr"
```

## prj.conf
```kconfig
# Release 087: the prj.conf of ../zephyr-cutoff (frozen), unchanged.
# Common: settings on NVS for the durable cutoff
CONFIG_FLASH=y
CONFIG_FLASH_MAP=y
CONFIG_NVS=y
CONFIG_SETTINGS=y
CONFIG_SETTINGS_NVS=y
CONFIG_LOG=y
CONFIG_MAIN_STACK_SIZE=4096

# Networking + MQTT (native_sim variant)
CONFIG_NETWORKING=y
CONFIG_NET_SOCKETS=y
CONFIG_NET_TCP=y
CONFIG_NET_IPV4=y
CONFIG_MQTT_LIB=y
CONFIG_ZVFS_POLL_MAX=8
```

## boards/native_sim.conf
```kconfig
# native_sim: host BSD sockets (Native Simulator offloaded sockets, NSOS), so the firmware reaches
# the broker (VM-B) and evicon-plant (127.0.0.1:18092) without TAP setup. Release 068: the
# offload options NSOS depends on were missing, so 067's NSOS line was ignored (found by the
# first real Zephyr build). Flash is simulated and backed by a file (--flash=<file>), which keeps
# the cutoff across restarts.
CONFIG_ETH_NATIVE_TAP=n
CONFIG_NET_DRIVERS=y
CONFIG_NET_SOCKETS_OFFLOAD=y
CONFIG_NET_NATIVE_OFFLOADED_SOCKETS=y
CONFIG_HEAP_MEM_POOL_SIZE=2048
```

## boards/native_sim_native_64.conf
```kconfig
# Same as native_sim.conf, for the 64-bit board target native_sim/native/64 (release 068: the
# build uses it, so the executable needs no 32-bit libraries on VM-E). Zephyr merges only the
# conf file named after the exact board target.
# native_sim: host BSD sockets (Native Simulator offloaded sockets, NSOS), so the firmware reaches
# the broker (VM-B) and evicon-plant (127.0.0.1:18092) without TAP setup. Release 068: the
# offload options NSOS depends on were missing, so 067's NSOS line was ignored (found by the
# first real Zephyr build). Flash is simulated and backed by a file (--flash=<file>), which keeps
# the cutoff across restarts.
CONFIG_ETH_NATIVE_TAP=n
CONFIG_NET_DRIVERS=y
CONFIG_NET_SOCKETS_OFFLOAD=y
CONFIG_NET_NATIVE_OFFLOADED_SOCKETS=y
CONFIG_HEAP_MEM_POOL_SIZE=2048
```

## src/evc_boot_report.c
```c
/*
 * Boot report of the EviCon cutoff firmware (release 087; see evc_boot_report.h and ../CMakeLists.txt). Compiled into
 * firmware/zephyr-boot only; the measured firmware (../zephyr-cutoff) does not contain it.
 */
#include "evc_boot_report.h"

#include <stdio.h>
#include <string.h>

#include "evc_core.h"

static uint64_t boot_floor;

uint64_t evc_boot_floor(void)
{
	return boot_floor;
}

int evc_boot_append_floor(const char *in, size_t len, char *buf, size_t n, uint64_t floor)
{
	if (in == NULL || len < 2 || in[0] != '{' || in[len - 1] != '}') {
		return -1;
	}
	int m;
	if (len == 2) {
		m = snprintf(buf, n, "{\"floor\":%llu}", (unsigned long long)floor);
	} else {
		m = snprintf(buf, n, "%.*s,\"floor\":%llu}", (int)(len - 1), in, (unsigned long long)floor);
	}
	return (m <= 0 || (size_t)m >= n) ? -1 : m;
}

int evc_boot_hello_topic(const char *cmd, size_t len, char *buf, size_t n, char *dev, size_t n_dev)
{
	static const char suffix[] = "/cmd";
	size_t ls = sizeof(suffix) - 1;
	if (cmd == NULL || len <= ls || memcmp(cmd + len - ls, suffix, ls) != 0) {
		return -1;
	}
	size_t base = len - ls; /* "<ns>/<dev>" */
	size_t slash = base;
	while (slash > 0 && cmd[slash - 1] != '/') {
		slash--;
	}
	if (slash == 0 || base - slash == 0 || base - slash >= n_dev) {
		return -1;
	}
	memcpy(dev, cmd + slash, base - slash);
	dev[base - slash] = '\0';
	int m = snprintf(buf, n, "%.*s/hello", (int)base, cmd);
	return (m <= 0 || (size_t)m >= n) ? -1 : m;
}

void evc_boot_core_init(struct evc_core *c, const struct evc_persisted *p, int64_t horizon_ms, uint32_t bound, unsigned flags);

void evc_boot_core_init(struct evc_core *c, const struct evc_persisted *p, int64_t horizon_ms, uint32_t bound, unsigned flags)
{
	boot_floor = p != NULL ? p->hw_limit : 0;
	evc_core_init(c, p, horizon_ms, bound, flags);
}

#ifndef EVC_BOOT_HOST_CORE_ONLY
#include <zephyr/net/mqtt.h>

int evc_boot_mqtt_publish(struct mqtt_client *client, const struct mqtt_publish_param *param);
int evc_boot_mqtt_subscribe(struct mqtt_client *client, const struct mqtt_subscription_list *list);

static char out[640];

int evc_boot_mqtt_publish(struct mqtt_client *client, const struct mqtt_publish_param *param)
{
	struct mqtt_publish_param p = *param;
	int m = evc_boot_append_floor((const char *)param->message.payload.data, param->message.payload.len, out, sizeof(out),
				      boot_floor);
	if (m > 0) {
		p.message.payload.data = (uint8_t *)out;
		p.message.payload.len = (uint32_t)m;
	}
	return mqtt_publish(client, &p);
}

int evc_boot_mqtt_subscribe(struct mqtt_client *client, const struct mqtt_subscription_list *list)
{
	static uint16_t hello_mid = 0xF000;
	static char topic[128];
	static char body[256];
	char dev[64];
	int rc = mqtt_subscribe(client, list);
	if (rc != 0 || list == NULL || list->list_count == 0) {
		return rc;
	}
	int lt = evc_boot_hello_topic((const char *)list->list[0].topic.utf8, list->list[0].topic.size, topic, sizeof(topic), dev,
				      sizeof(dev));
	if (lt < 0) {
		return rc;
	}
	int lb = snprintf(body, sizeof(body), "{\"device\":\"%s\",\"hello\":true,\"floor\":%llu}", dev, (unsigned long long)boot_floor);
	if (lb <= 0 || (size_t)lb >= sizeof(body)) {
		return rc;
	}
	struct mqtt_publish_param p;
	memset(&p, 0, sizeof(p));
	p.message.topic.qos = MQTT_QOS_1_AT_LEAST_ONCE;
	p.message.topic.topic.utf8 = (const uint8_t *)topic;
	p.message.topic.topic.size = (uint32_t)lt;
	p.message.payload.data = (uint8_t *)body;
	p.message.payload.len = (uint32_t)lb;
	p.message_id = hello_mid++;
	if (hello_mid < 0xF000) {
		hello_mid = 0xF000;
	}
	(void)mqtt_publish(client, &p); /* best effort: the floor also travels with every reply */
	return rc;
}
#endif
```

## src/evc_boot_report.h
```c
/*
 * Boot report of the EviCon cutoff firmware (release 087; firmware/zephyr-boot, PREREG_extra_087.md item B).
 *
 * The claim floor F is the claim high-water mark that evc_core_init restored at this boot (0 on a fresh flash): no
 * identity with a sequence at or below F takes effect any more (the eviction guard), and every identity above F that
 * took effect did so in this boot (the claim mark is persisted before every effect and never falls). So the RAM level
 * of this boot is the sum of the values of the identities above F that took effect. The firmware reports F with every
 * answer and in a hello after every (re)connect; the gateway passes it on as "claim_floor" and the authority's reboot
 * recovery (evicon-authority -reboot-recovery) uses it.
 */
#ifndef EVC_BOOT_REPORT_H
#define EVC_BOOT_REPORT_H

#include <stddef.h>
#include <stdint.h>

/* in[0..len) is a JSON object; writes it with ,"floor":F (or {"floor":F} for {}) into buf. Returns the new length,
 * or -1 when in is not an object or buf is too small (the caller then publishes in unchanged). */
int evc_boot_append_floor(const char *in, size_t len, char *buf, size_t n, uint64_t floor);

/* The hello topic of a command topic "<ns>/<dev>/cmd": "<ns>/<dev>/hello". Returns its length, -1 if cmd is not of
 * that form or buf is too small. dev (n_dev bytes) receives the device segment. */
int evc_boot_hello_topic(const char *cmd, size_t len, char *buf, size_t n, char *dev, size_t n_dev);

/* The floor recorded at boot. */
uint64_t evc_boot_floor(void);

#endif
```
